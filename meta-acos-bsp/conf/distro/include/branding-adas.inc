## meta-acos-bsp/conf/distro/include/edgeai-source-ipk.inc
```bitbake
# Enable source ipk packages and install directories
INHERIT:pn-edgeai-apps-utils += "sourceipk"
SRCIPK_INCLUDE_EXTRAFILES:pn-edgeai-apps-utils = "0"
CREATE_SRCIPK:pn-edgeai-apps-utils ?= "1"
SRCIPK_INSTALL_DIR:pn-edgeai-apps-utils ?= "edgeai-app-stack/${PN}"
SRCIPK_SHALLOW_CLONE:pn-edgeai-apps-utils ?= "true"
SRCIPK_PRESERVE_GIT:pn-edgeai-apps-utils ?= "true"

INHERIT:pn-edgeai-dl-inferer += "sourceipk"
SRCIPK_INCLUDE_EXTRAFILES:pn-edgeai-dl-inferer = "0"
CREATE_SRCIPK:pn-edgeai-dl-inferer ?= "1"
SRCIPK_INSTALL_DIR:pn-edgeai-dl-inferer ?= "edgeai-app-stack/${PN}"
SRCIPK_SHALLOW_CLONE:pn-edgeai-dl-inferer ?= "true"
SRCIPK_PRESERVE_GIT:pn-edgeai-dl-inferer ?= "true"

INHERIT:pn-edgeai-gst-apps += "sourceipk"
SRCIPK_INCLUDE_EXTRAFILES:pn-edgeai-gst-apps = "0"
CREATE_SRCIPK:pn-edgeai-gst-apps ?= "1"
SRCIPK_INSTALL_DIR:pn-edgeai-gst-apps ?= "edgeai-app-stack/${PN}"
SRCIPK_SHALLOW_CLONE:pn-edgeai-gst-apps ?= "true"
SRCIPK_PRESERVE_GIT:pn-edgeai-gst-apps ?= "true"

INHERIT:pn-edgeai-gst-plugins += "sourceipk"
SRCIPK_INCLUDE_EXTRAFILES:pn-edgeai-gst-plugins = "0"
CREATE_SRCIPK:pn-edgeai-gst-plugins ?= "1"
SRCIPK_INSTALL_DIR:pn-edgeai-gst-plugins ?= "edgeai-app-stack/${PN}"
SRCIPK_SHALLOW_CLONE:pn-edgeai-gst-plugins ?= "true"
SRCIPK_PRESERVE_GIT:pn-edgeai-gst-plugins ?= "true"

INHERIT:pn-edgeai-tiovx-kernels += "sourceipk"
SRCIPK_INCLUDE_EXTRAFILES:pn-edgeai-tiovx-kernels = "0"
CREATE_SRCIPK:pn-edgeai-tiovx-kernels ?= "1"
SRCIPK_INSTALL_DIR:pn-edgeai-tiovx-kernels ?= "edgeai-app-stack/${PN}"
SRCIPK_SHALLOW_CLONE:pn-edgeai-tiovx-kernels ?= "true"
SRCIPK_PRESERVE_GIT:pn-edgeai-tiovx-kernels ?= "true"

INHERIT:pn-edgeai-tiovx-modules += "sourceipk"
SRCIPK_INCLUDE_EXTRAFILES:pn-edgeai-tiovx-modules = "0"
CREATE_SRCIPK:pn-edgeai-tiovx-modules ?= "1"
SRCIPK_INSTALL_DIR:pn-edgeai-tiovx-modules ?= "edgeai-app-stack/${PN}"
SRCIPK_SHALLOW_CLONE:pn-edgeai-tiovx-modules ?= "true"
SRCIPK_PRESERVE_GIT:pn-edgeai-tiovx-modules ?= "true"
```

## meta-acos-core/conf/distro/acos.conf
```bitbake
require conf/distro/poky.conf

# Insert overrides "acosdefaulttune" and "forcedefaulttune" before forcevariable
OVERRIDES = "${TARGET_OS}:${TRANSLATED_TARGET_ARCH}:pn-${PN}:${MACHINEOVERRIDES}:${DISTROOVERRIDES}:${CLASSOVERRIDE}${LIBCOVERRIDE}:acosdefaulttune:forcedefaulttune:forcevariable"

# ACOS specific derivations
DISTRO = "acos"
DISTRO_NAME = "autocore os"


# Release flags
DISTRO_CODENAME = "acos"
ACOS_BRANCH = "master"
ACOSVERSION = "0.0.1"

# switch  devel/release
ACOSRELEASETYPE ?= "acosdevelopment"
#ACOSRELEASETYPE := "acosrelease"

OVERRIDES .= ":${ACOSRELEASETYPE}"

#for development
DISTRO_VERSION:acosdevelopment := "${ACOSVERSION}+snapshot-${METADATA_REVISION}"

#for release
DISTRO_VERSION:acosrelease := "${ACOSVERSION}"
DISTRO_BRANCH_VERSION_TAG = "${DISTRO_CODENAME}/${@'${DISTRO_VERSION}'.replace('+snapshot-${METADATA_REVISION}','')}"

# reproducible builds:
# Set the desired timestamps
# E.g. update for (major) releases
export SOURCE_DATE_EPOCH = "1706800000"
REPRODUCIBLE_TIMESTAMP_ROOTFS = "1706800000"


# SDK
SDK_VENDOR = "-acossdk"

# SDKPATHINSTALL is the folder where the SDK is going to be installed
# Due to an issue with the qt5 environment (see SPEC-1667),
# we add DEFAULTTUNE to the SDKPATH to mitigate the issue.
SDKPATHINSTALL = "/opt/acos-sdk/${SDK_VERSION}-${DEFAULTTUNE}"


#MAINTAINER = "ACOS https://lists.automotivelinux.org/g/acos-dev-community"


# Override these in poky based distros
#ACOS_DEFAULT_DISTRO_FEATURES = "usrmerge largefile opengl wayland pam bluetooth bluez5 3g polkit"
ACOS_DEFAULT_DISTRO_FEATURES = " "
POKY_DEFAULT_DISTRO_FEATURES := "${ACOS_DEFAULT_DISTRO_FEATURES}"
OVERRIDES .= ":${DISTRO_CODENAME}"

DISTRO_FEATURES:remove = "x11 alsa bluetooth debuginfod ext2 wifi 3g nfc argp largefile pcmcia usbgadget usbhost ipv6"
DISTRO_FEATURES_BACKFILL_CONSIDERED = "pulseaudio"

INIT_MANAGER = "systemd"
# Override default of "systemd-compat-units"
VIRTUAL-RUNTIME_initscripts = ""
# Override default of "busybox-syslog"
VIRTUAL-RUNTIME_base-utils-syslog = ""

# network manager to use (possible values: systemd, connman)
VIRTUAL-RUNTIME_net_manager = "systemd"


QEMU_TARGETS ?= "arm aarch64 i386 x86_64 riscv64"
# Other QEMU_TARGETS "mips mips64 mips64el ppc sh4"

# The CONNECTIVITY_CHECK_URI's are used to test whether we can succesfully
# fetch from the network (and warn you if not). To disable the test set
# the variable to be empty.
# Git example url: git://git.yoctoproject.org/yocto-firewall-test;protocol=git;rev=HEAD
CONNECTIVITY_CHECK_URIS ?= ""

# using multiple BSP layers causes dangling bbappends in meta-acos-bsp
# turn it into a warning
#BB_DANGLINGAPPENDS_WARNONLY = "1"

# Not yet upstreamed; should be submitted.
SECURITY_CFLAGS:pn-qtwebengine = "${SECURITY_NO_PIE_CFLAGS}"

#Redefined USER_CLASSES
#Disable prelink. It is unmaintained and likely will go away.
#default: USER_CLASSES ?= "buildstats image-prelink"
USER_CLASSES = "buildstats"

# ACOS uses 4 optimization levels
# 2 for ARM 32bit 
#   - a high and a medium setting for the CCARGS
#   - the high setting is default (needs >= cortex-a15)
#   - the medium setting is enabled with: DISTRO_FEATURES:append = " acos-medium-arm-compiler "
# 1 for ARM 64bit / AARCH64
# 1 for x86-64
# 1 for RISC-V 64-bit
require conf/distro/include/${TARGET_ARCH}-tune.inc

# Generic qemu and qemuboot (runqemu) enhancements
# check qemuboot.bbclass
# - use 2G RAM by default
QB_MEM ?= "-m 2048"
# use pulseaudio on the host side - off as qemu-native is built with alsa
#QB_AUDIO_DRV = "pa"
# expose a virtual 'hda' sound card to the guest (arm/aarch64/x86-64)
QB_AUDIO_OPT = "-device intel-hda -device hda-duplex -audiodev alsa,id=acos"

# Board templates can add extra IMAGE_FSTYPES through this.
# It is added (late) through the ACOS image recipes.
ACOS_EXTRA_IMAGE_FSTYPES ??= ""
ACOS_EXTRA_INITRAMFS_FSTYPES ??= ""
#
# Default IMAGE FSTYPES wic.xz
ACOS_DEFAULT_IMAGE_FSTYPES ?= "wic.xz wic.bmap wic.bz2"
ACOS_DEFAULT_IMAGE_FSTYPES:qemuall ?= "${@bb.utils.contains('ACOS_FEATURES', 'ACOSCI', 'ext4.xz', 'ext4', d)}"
ACOS_DEFAULT_INITRAMFS_FSTYPES ?= "ext4.gz"
# add new partion so must exclude these dirctory from  rootfs
ACOS_CUSTOME_EXCLUDE_ROOTFS ?= "opt data custom boot"
#IMAGE_INSTALL += "repart"
REPART_DEV ?= "mmcblk0"
REPART_NO ?= "6"
REPART_MOUNTPOINT ?= "/data"
REPART_MOUNT_SERVICE ?= "data"
REPART_MOUNTCUSTOM ?= "/custom"
WIC_CREATE_EXTRA_ARGS += " --no-fstab-update"
#"
# DEFAULT IMAGE_FSTYPES for ACOS (no - BSPs should not set this)
#
IMAGE_FSTYPES ?= "${ACOS_DEFAULT_IMAGE_FSTYPES} ${ACOS_EXTRA_IMAGE_FSTYPES}"
INITRAMFS_FSTYPES = "${ACOS_DEFAULT_INITRAMFS_FSTYPES} ${ACOS_EXTRA_INITRAMFS_FSTYPES}"
#

# Fix for rpm metadata clash between nativesdk-cmake and nativesdk-qtbase-tools
# (revalidate after 2017-10-15, 2018-06-12: still required)
DIRFILES:pn-nativesdk-cmake = "1"

# For https://jira.automotivelinux.org/browse/SPEC-1629 :
# We exclude the conflicting vars from the sstate task hash.
# This needs to be verified.
do_package_write_rpm[vardepsexclude] += "ARCHIVER_TOPDIR PF"
TARGET_VENDOR="-oe"
IMAGE_FEATURES += "autologin"
```

## meta-acos-core/conf/distro/include/riscv64-tune.inc
```bitbake
# DEFAULTTUNE overrides for ACOS on riscv64

# We should not need the tuning include below as the BSP should include the right set already.
# A double inclusion would produce a warning. This include line is just for reference
# include conf/machine/include/arm/arch-armv8.inc

ACOS_DEFAULTTUNE ?= "riscv64"
DEFAULTTUNE:acosdefaulttune = "${ACOS_DEFAULTTUNE}"
```

## meta-acos-core/conf/layer.conf
```bitbake
# We have a conf and classes directory, add to BBPATH
BBPATH =. "${LAYERDIR}:"

# We have recipes-* directories, add to BBFILES
BBFILES += "${LAYERDIR}/recipes-*/*/*.bb \
            ${LAYERDIR}/recipes-*/*/*.bbappend"

BBFILE_COLLECTIONS += "meta-acos-core"
BBFILE_PATTERN_meta-acos-core = "^${LAYERDIR}/"
BBFILE_PRIORITY_meta-acos-core = "60"

LAYERDEPENDS_meta-acos-core = "meta-acos-core"
LAYERSERIES_COMPAT_meta-acos-core = "kirkstone"
```
